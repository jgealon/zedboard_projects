/ {
	amba_pl: amba_pl {
		ranges;
		compatible = "simple-bus";
		#address-cells = <1>;
		#size-cells = <1>;
		axi_mm2s_interface_0: axi_mm2s_interface@40000000 {
			xlnx,rable = <0>;
			compatible = "xlnx,axi-mm2s-interface-1.0";
			status = "okay";
			clock-names = "aclk";
			xlnx,ip-name = "axi_mm2s_interface";
			xlnx,edk-iptype = "PERIPHERAL";
			reg = <0x40000000 0x1000>;
			clocks = <&clkc 15>;
			xlnx,name = "axi_mm2s_interface_0";
		};
		axi_s2mm_interface_0: axi_s2mm_interface@41000000 {
			xlnx,rable = <0>;
			compatible = "xlnx,axi-s2mm-interface-1.0";
			status = "okay";
			clock-names = "aclk";
			xlnx,ip-name = "axi_s2mm_interface";
			xlnx,edk-iptype = "PERIPHERAL";
			reg = <0x41000000 0x1000>;
			clocks = <&clkc 15>;
			xlnx,name = "axi_s2mm_interface_0";
		};
	};
};
