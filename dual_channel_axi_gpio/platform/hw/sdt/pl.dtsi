/ {
	amba_pl: amba_pl {
		ranges;
		compatible = "simple-bus";
		#address-cells = <1>;
		#size-cells = <1>;
		axi_gpio_0: axi_gpio@41200000 {
			xlnx,gpio-board-interface = "sws_8bits";
			compatible = "xlnx,axi-gpio-2.0" , "xlnx,xps-gpio-1.00.a";
			xlnx,all-outputs = <0>;
			xlnx,gpio-width = <8>;
			xlnx,rable = <0>;
			xlnx,dout-default = <0x00000000>;
			xlnx,is-dual = <1>;
			xlnx,ip-name = "axi_gpio";
			xlnx,tri-default-2 = <0xFFFFFFFF>;
			reg = <0x41200000 0x10000>;
			xlnx,all-inputs-2 = <0>;
			clocks = <&clkc 15>;
			xlnx,all-outputs-2 = <1>;
			xlnx,interrupt-present = <0>;
			xlnx,gpio2-board-interface = "leds_8bits";
			xlnx,edk-iptype = "PERIPHERAL";
			xlnx,dout-default-2 = <0x00000000>;
			xlnx,gpio2-width = <8>;
			status = "okay";
			clock-names = "s_axi_aclk";
			xlnx,use-board-flow;
			xlnx,tri-default = <0xFFFFFFFF>;
			xlnx,name = "axi_gpio_0";
			xlnx,all-inputs = <1>;
		};
	};
};
