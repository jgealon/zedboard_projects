/ {
	amba_pl: amba_pl {
		ranges;
		compatible = "simple-bus";
		#address-cells = <1>;
		#size-cells = <1>;
		axi_gpio_0: axi_gpio@41200000 {
			#interrupt-cells = <2>;
			interrupts = < 0 29 4 >;
			xlnx,gpio-board-interface = "sws_8bits";
			compatible = "xlnx,axi-gpio-2.0" , "xlnx,xps-gpio-1.00.a";
			xlnx,all-outputs = <0>;
			xlnx,gpio-width = <8>;
			interrupt-parent = <&intc>;
			xlnx,rable = <0>;
			xlnx,dout-default = <0x00000000>;
			xlnx,is-dual = <0>;
			xlnx,ip-name = "axi_gpio";
			xlnx,tri-default-2 = <0xFFFFFFFF>;
			reg = <0x41200000 0x10000>;
			xlnx,all-inputs-2 = <0>;
			clocks = <&clkc 15>;
			xlnx,all-outputs-2 = <0>;
			xlnx,interrupt-present = <1>;
			xlnx,gpio2-board-interface = "Custom";
			xlnx,edk-iptype = "PERIPHERAL";
			xlnx,dout-default-2 = <0x00000000>;
			xlnx,gpio2-width = <32>;
			status = "okay";
			clock-names = "s_axi_aclk";
			xlnx,use-board-flow;
			interrupt-controller;
			interrupt-names = "ip2intc_irpt";
			xlnx,tri-default = <0xFFFFFFFF>;
			xlnx,name = "axi_gpio_0";
			xlnx,all-inputs = <1>;
		};
		axi_gpio_1: axi_gpio@41210000 {
			#interrupt-cells = <2>;
			interrupts = < 0 30 4 >;
			xlnx,gpio-board-interface = "btns_5bits";
			compatible = "xlnx,axi-gpio-2.0" , "xlnx,xps-gpio-1.00.a";
			xlnx,all-outputs = <0>;
			xlnx,gpio-width = <5>;
			interrupt-parent = <&intc>;
			xlnx,rable = <0>;
			xlnx,dout-default = <0x00000000>;
			xlnx,is-dual = <0>;
			xlnx,ip-name = "axi_gpio";
			xlnx,tri-default-2 = <0xFFFFFFFF>;
			reg = <0x41210000 0x10000>;
			xlnx,all-inputs-2 = <0>;
			clocks = <&clkc 15>;
			xlnx,all-outputs-2 = <0>;
			xlnx,interrupt-present = <1>;
			xlnx,gpio2-board-interface = "Custom";
			xlnx,edk-iptype = "PERIPHERAL";
			xlnx,dout-default-2 = <0x00000000>;
			xlnx,gpio2-width = <32>;
			status = "okay";
			clock-names = "s_axi_aclk";
			xlnx,use-board-flow;
			interrupt-controller;
			interrupt-names = "ip2intc_irpt";
			xlnx,tri-default = <0xFFFFFFFF>;
			xlnx,name = "axi_gpio_1";
			xlnx,all-inputs = <1>;
		};
	};
};
